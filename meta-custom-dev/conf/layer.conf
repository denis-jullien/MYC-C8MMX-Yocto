## meta-custom-dev/conf/layer.conf
```bitbake
# We have a conf and classes directory, add to BBPATH
BBPATH .= ":${LAYERDIR}"

# We have recipes-* directories, add to BBFILES
BBFILES += "${LAYERDIR}/recipes-*/*/*.bb \
            ${LAYERDIR}/recipes-*/*/*.bbappend"

BBFILE_COLLECTIONS += "meta-custom-dev"
BBFILE_PATTERN_meta-custom-dev = "^${LAYERDIR}/"
BBFILE_PRIORITY_meta-custom-dev = "6"

LAYERDEPENDS_meta-custom-dev = "core"
LAYERSERIES_COMPAT_meta-custom-dev = "warrior zeus"
```
